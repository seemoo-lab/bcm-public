## kernel/drivers/net/wireless/nexdhd/Kconfig
```kconfig
config NEXDHD
	tristate "NEXDHD Broadcom 4329/30 wireless cards support"
	depends on MMC
	---help---
	  This module adds support for wireless adapters based on
	  Broadcom 4329/30 chipset.

	  This driver uses the kernel's wireless extensions subsystem.

	  If you choose to build a module, it'll be called dhd. Say M if
	  unsure.

config NEXDHD_BCM4339
	tristate "NEXDHD Broadcom 4339 wireless cards support"
	depends on NEXDHD
	---help---
	  This module adds support for wireless adapters based on
	  Broadcom 4339 chipset.

config NEXDHD_FW_PATH
	depends on NEXDHD
	string "NEXDHD Firmware path"
	default "/nexmon/firmware/fw_nexdhd.bin"
	---help---
	  Path to the firmware file.

config NEXDHD_NVRAM_PATH
	depends on NEXDHD
	string "NEXDHD NVRAM path"
	default "/nexmon/firmware/nexdhd.cal"
	---help---
	  Path to the calibration file.

config NEXDHD_WEXT
	bool "NEXDHD Enable WEXT support"
	depends on NEXDHD && CFG80211 = n
	select WIRELESS_EXT
	select WEXT_PRIV
	help
	  Enables WEXT support

config NEXDHD_DHD_USE_STATIC_BUF
	bool "NEXDHD Enable memory preallocation"
	depends on NEXDHD
	default n
	---help---
	  Use memory preallocated in platform

config NEXDHD_DHD_USE_SCHED_SCAN
	bool "NEXDHD Use CFG80211 sched scan"
	depends on NEXDHD && CFG80211
	default n
	---help---
	  Use CFG80211 sched scan
```

## kernel/drivers/net/wireless/nexmon/Kconfig
```kconfig
config NEXMON
	tristate "NEXMON Broadcom 4329/30 wireless cards support"
	depends on MMC
	---help---
	  This module adds support for wireless adapters based on
	  Broadcom 4329/30 chipset.

	  This driver uses the kernel's wireless extensions subsystem.

	  If you choose to build a module, it'll be called dhd. Say M if
	  unsure.

config NEXMON_BCM4339
	tristate "NEXMON Broadcom 4339 wireless cards support"
	depends on NEXMON
	---help---
	  This module adds support for wireless adapters based on
	  Broadcom 4339 chipset.

config NEXMON_FW_PATH
	depends on NEXMON
	string "NEXMON Firmware path"
	default "/nexmon/firmware/fw_nexmon.bin"
	---help---
	  Path to the firmware file.

config NEXMON_NVRAM_PATH
	depends on NEXMON
	string "NEXMON NVRAM path"
	default "/nexmon/firmware/nexmon.cal"
	---help---
	  Path to the calibration file.

config NEXMON_WEXT
	bool "NEXMON Enable WEXT support"
	depends on NEXMON && CFG80211 = n
	select WIRELESS_EXT
	select WEXT_PRIV
	help
	  Enables WEXT support

config NEXMON_DHD_USE_STATIC_BUF
	bool "NEXMON Enable memory preallocation"
	depends on NEXMON
	default n
	---help---
	  Use memory preallocated in platform

config NEXMON_DHD_USE_SCHED_SCAN
	bool "NEXMON Use CFG80211 sched scan"
	depends on NEXMON && CFG80211
	default n
	---help---
	  Use CFG80211 sched scan
```
