MEMORY
{
	rom : ORIGIN = 0x0, LENGTH = 640K
	ram : ORIGIN = 0x180000, LENGTH = 768K
	patch : ORIGIN = 0x180020, LENGTH = 0x7e0
	ucode : ORIGIN = 0x1FD82C, LENGTH = 0xa6e0
	fpconfig : ORIGIN = 0x207F0C, LENGTH = 0xc00
}
/* 0x1FD820 on .40 firmware */

SECTIONS
{
	/* include the patch.generated.ld file that was generated by the nexmon gcc plugin after evaluating the "at" attributes */
	INCLUDE flashpatches.generated.ld
	INCLUDE nexmon.generated.ld
}
